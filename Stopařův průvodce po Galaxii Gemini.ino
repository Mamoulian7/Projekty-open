#include <Arduino.h>
#include <WiFi.h>
#include <HTTPClient.h>
#include <ArduinoJson.h>
#include <SPI.h>
#include <Adafruit_GFX.h>
#include <GxEPD2_3C.h>
#include <U8g2_for_Adafruit_GFX.h>
#include <driver/i2s.h>
#include <WiFiClientSecure.h>
#include "mbedtls/base64.h"

// =========================================================================
//  STOPAŘŮV PRŮVODCE PO GALAXII (Mk.III) - ESP32-S3 + E-PAPER + GEMINI AI
// =========================================================================

// --- 1. NASTAVENÍ WI-FI ---
const char* ssid = "XXX";
const char* password = "XXX";

// --- 2. API KLÍČE A MODEL ---
// Model pro Gemini: gemini-3.6-flash (gemini-2.5-flash byl Googlem ukončen s chybou 404)
#define GEMINI_MODEL "gemini-3.6-flash"

// Klíč z Google AI Studia (pro texty průvodce):
#define GEMINI_API_KEY "XXX"

// Klíč z Google Cloud Console (s povoleným Cloud Speech-to-Text API):
#define GOOGLE_SPEECH_KEY "XXX"

// Pokud byste někdy chtěl použít OpenAI Whisper místo Google Speech, přepněte na 0:
#define USE_GOOGLE_SPEECH 1 
#define OPENAI_API_KEY "SK-SEM_VLOZTE_OPENAI_KLIC"

// --- 3. PINY DISPLEJE (ESP32-S3) ---
#define EPD_PWR  8
#define EPD_BUSY 9
#define EPD_RST  10
#define EPD_DC   11
#define EPD_CS   12
#define EPD_MOSI 13
#define EPD_SCK  14
#define EPD_MISO -1 // Nepoužívá se

// --- 4. PINY JOYSTICKU (ESP32-S3) ---
#define BTN_HOME    4  
#define BTN_RANDOM  5  
#define BTN_SEARCH  6  
#define BTN_UP      7  
#define BTN_DWN     15  
#define BTN_LEFT    16  
#define BTN_RIGHT   17  

// --- 5. PINY ZVUKU A MIKROFONU (ESP32-S3) ---
#define BUZZER_PIN  18 
#define I2S_BCLK    42
#define I2S_LRCLK   41
#define I2S_DOUT    40

// --- INICIALIZACE DISPLEJE A PÍSEM ---
GxEPD2_3C<GxEPD2_420c_GDEY042Z98, GxEPD2_420c_GDEY042Z98::HEIGHT> display(GxEPD2_420c_GDEY042Z98(EPD_CS, EPD_DC, EPD_RST, EPD_BUSY));
U8G2_FOR_ADAFRUIT_GFX u8g2Fonts;

// --- PROMĚNNÉ A STAV ---
String currentTitle = "";
String currentText = "";
int currentPage = 0;
const int CHARS_PER_PAGE = 450; 
bool isReadingArticle = false;

// =========================================================================
//  LOGO NA ÚVODNÍ OBRAZOVCE (ORIGINÁLNÍ 200x200px BITMAPA DON'T PANIC)
// =========================================================================
#define LOGO_WIDTH  200
#define LOGO_HEIGHT 200
#define INVERT_LOGO 0 // Pokud by se barvy na displeji jevily invertovane, prepnete na 1

const unsigned char logo_dont_panic [] PROGMEM = {
	0x00, 0x00, 0x00, 0x00, 0x00, 0x00, 0x00, 0x00, 0x00, 0x00, 0x00, 0x00, 0x00, 0x00, 0x00, 0x00, 
	0x00, 0x00, 0x00, 0x00, 0x00, 0x00, 0x00, 0x00, 0x00, 0x00, 0x00, 0x00, 0x00, 0x00, 0x00, 0x00, 
	0x00, 0x00, 0x00, 0x00, 0x00, 0x00, 0x00, 0x00, 0x00, 0x00, 0x00, 0x00, 0x00, 0x00, 0x00, 0x00, 
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	0x00, 0x00, 0x00, 0x00, 0x00, 0x00, 0x00, 0x00
};

void drawLogo(int x, int y) {
#if INVERT_LOGO
  display.drawInvertedBitmap(x, y, logo_dont_panic, LOGO_WIDTH, LOGO_HEIGHT, GxEPD_BLACK);
#else
  display.drawBitmap(x, y, logo_dont_panic, LOGO_WIDTH, LOGO_HEIGHT, GxEPD_BLACK);
#endif
}

// --- STRUKTURA PRO WAV HLAVIČKU (pro OpenAI Whisper) ---
#pragma pack(push, 1)
struct WAVHeader {
  char riff[4] = {'R', 'I', 'F', 'F'};
  uint32_t chunkSize;
  char wave[4] = {'W', 'A', 'V', 'E'};
  char fmt[4] = {'f', 'm', 't', ' '};
  uint32_t fmtSize = 16;
  uint16_t audioFormat = 1;
  uint16_t numChannels = 1;
  uint32_t sampleRate = 16000;
  uint32_t byteRate = 16000 * 2;
  uint16_t blockAlign = 2;
  uint16_t bitsPerSample = 16;
  char data[4] = {'d', 'a', 't', 'a'};
  uint32_t dataSize;
};
#pragma pack(pop)

// --- ZVUKOVÉ EFEKTY ---
void playBeep(int freq, int duration) {
  tone(BUZZER_PIN, freq, duration);
  delay(duration + 20);
}

void soundStartup() {
  playBeep(523, 100); // C5
  playBeep(659, 100); // E5
  playBeep(784, 100); // G5
  playBeep(1046, 200); // C6
}

void soundClick() {
  tone(BUZZER_PIN, 1200, 30);
}

void soundRandom() {
  // Zvuk nabíjení nepravděpodobnostního pohonu
  for (int i = 400; i < 1500; i += 100) {
    tone(BUZZER_PIN, i, 20);
    delay(20);
  }
  noTone(BUZZER_PIN);
}

void soundError() {
  playBeep(300, 250);
  playBeep(200, 400);
}

void soundRecordStart() {
  playBeep(1000, 100);
  playBeep(1500, 100);
}

void soundRecordStop() {
  playBeep(1500, 100);
  playBeep(1000, 100);
}

// --- POMOCNÉ FUNKCE PRO TEXT ---
String cleanMarkdown(String text) {
  text.replace("**", "");
  text.replace("*", "");
  text.replace("##", "");
  text.replace("#", "");
  text.replace("`", "");
  text.replace("\"", "");
  text.replace("\r", "");
  return text;
}

String cleanPunctuation(String text) {
  text.trim();
  while (text.length() > 0 && (text.endsWith(".") || text.endsWith(",") || text.endsWith("!") || text.endsWith("?"))) {
    text = text.substring(0, text.length() - 1);
  }
  return text;
}

// --- INICIALIZACE I2S MIKROFONU ---
void initI2S() {
  i2s_config_t i2s_config = {
    .mode = (i2s_mode_t)(I2S_MODE_MASTER | I2S_MODE_RX),
    .sample_rate = 16000,
    .bits_per_sample = I2S_BITS_PER_SAMPLE_32BIT,
    .channel_format = I2S_CHANNEL_FMT_ONLY_LEFT,
    .communication_format = I2S_COMM_FORMAT_STAND_I2S,
    .intr_alloc_flags = ESP_INTR_FLAG_LEVEL1,
    .dma_buf_count = 8,
    .dma_buf_len = 1024,
    .use_apll = false,
    .tx_desc_auto_clear = false,
    .fixed_mclk = 0
  };
  i2s_pin_config_t pin_config = {
    .bck_io_num = I2S_BCLK,
    .ws_io_num = I2S_LRCLK,
    .data_out_num = I2S_PIN_NO_CHANGE,
    .data_in_num = I2S_DOUT
  };
  i2s_driver_install(I2S_NUM_0, &i2s_config, 0, NULL);
  i2s_set_pin(I2S_NUM_0, &pin_config);
}

// --- DEKLARACE FUNKCÍ ---
void drawHomeScreen();
void drawLoadingScreen(String title, String subtitle);
void drawCurrentArticlePage();
void drawErrorScreen(String title, String message);
void fetchGeminiArticle(String prompt, String fallbackTitle);
void recordAndSearch();
void connectWiFi();
void checkWiFiConnection();

// =========================================================================
//  SETUP & LOOP
// =========================================================================
void setup() {
  Serial.begin(115200);
  delay(500);
  Serial.println("\n--- STOPARUV PRUVODCE PO GALAXII (GEMINI AI EDITION) ---");

  // Zvukový výstup
  pinMode(BUZZER_PIN, OUTPUT);
  soundStartup(); 

  // Tlačítka joysticku
  pinMode(BTN_HOME, INPUT_PULLDOWN);
  pinMode(BTN_RANDOM, INPUT_PULLDOWN);
  pinMode(BTN_SEARCH, INPUT_PULLDOWN);
  pinMode(BTN_UP, INPUT_PULLDOWN);
  pinMode(BTN_DWN, INPUT_PULLDOWN);
  pinMode(BTN_LEFT, INPUT_PULLDOWN);
  pinMode(BTN_RIGHT, INPUT_PULLDOWN);

  // Napájení e-paper displeje
  pinMode(EPD_PWR, OUTPUT);
  digitalWrite(EPD_PWR, HIGH);
  delay(100); 

  // SPI a inicializace displeje
  SPI.begin(EPD_SCK, EPD_MISO, EPD_MOSI, EPD_CS); 
  display.init(115200, true, 50, false); 
  display.setRotation(1); 

  // Písma
  u8g2Fonts.begin(display);
  u8g2Fonts.setFontMode(1);                 
  u8g2Fonts.setFontDirection(0);            
  
  // Wi-Fi a mikrofon
  connectWiFi();
  initI2S();

  // Úvodní obrazovka
  drawHomeScreen();
}

void loop() {
  // DOMŮ (vlevo nebo BTN_HOME)
  if (digitalRead(BTN_HOME) == HIGH || digitalRead(BTN_LEFT) == HIGH) {
    soundClick();
    drawHomeScreen();
    delay(800); 
  }
  
  // NÁHODA (doprava nebo BTN_RANDOM) -> Dotaz na Gemini o reálná encyklopedická fakta
  if (digitalRead(BTN_RANDOM) == HIGH || digitalRead(BTN_RIGHT) == HIGH) {
    soundRandom();
    drawLoadingScreen("Hledám fakta...", "Gemini vybíra zajimavé téma");
    
    String prompt = "Vyber jedno zajimave, realne encyklopedicke tema nebo fascinujici vedecky, historicky, vesmirny ci prirodni fakt. "
                   "Vysvetli ho vecne, srozumitelne a poutave, presne jako v chytre encyklopedii nebo aplikaci Gemini v telefonu. "
                   "Odpovez v cestine. Zadny markdown, zadne formatovani, zadne hvezdicky, zadne uvozovky, zadne odrazky. "
                   "Na 1. radku POUZE a jedine strucny nazev hesla (max 4 slova). "
                   "Pak jeden prazdny radek. "
                   "Pak samotny text clanku s realnymi fakty a vysvetlenim (cca 120 az 180 slov).";
                   
    fetchGeminiArticle(prompt, "Náhodné heslo");
    delay(800);
  }
  
  // HLASOVÉ VYHLEDÁVÁNÍ (středové tlačítko BTN_SEARCH)
  if (digitalRead(BTN_SEARCH) == HIGH) {
    recordAndSearch();
    delay(800);
  }

  // LISTOVÁNÍ DOLŮ
  if (digitalRead(BTN_DWN) == HIGH && isReadingArticle) {
    int maxPages = (currentText.length() <= 0) ? 1 : ((currentText.length() - 1) / CHARS_PER_PAGE + 1);
    if (currentPage < maxPages - 1) {
      soundClick();
      currentPage++;
      drawCurrentArticlePage();
    } else {
      soundError(); 
    }
    delay(600);
  }

  // LISTOVÁNÍ NAHORU
  if (digitalRead(BTN_UP) == HIGH && isReadingArticle) {
    if (currentPage > 0) {
      soundClick();
      currentPage--;
      drawCurrentArticlePage();
    } else {
      soundError(); 
    }
    delay(600);
  }
  
  delay(50);
}

// --- SPRÁVA WI-FI ---
void connectWiFi() {
  Serial.print("Připojování k Wi-Fi: ");
  Serial.println(ssid);
  WiFi.begin(ssid, password);
  int attempts = 0;
  while (WiFi.status() != WL_CONNECTED && attempts < 30) {
    delay(500);
    Serial.print(".");
    attempts++;
  }
  if (WiFi.status() == WL_CONNECTED) {
    Serial.println("\nWi-Fi pripojeno! IP: " + WiFi.localIP().toString());
  } else {
    Serial.println("\nChyba pripojeni k Wi-Fi!");
  }
}

void checkWiFiConnection() {
  if (WiFi.status() != WL_CONNECTED) {
    connectWiFi();
  }
}

// =========================================================================
//  GEMINI API VOLÁNÍ (Model gemini-3.6-flash s nízkou latencí)
// =========================================================================
//  GEMINI API VOLÁNÍ (Model gemini-3.6-flash přes přímé HTTPS spojení)
// =========================================================================
void fetchGeminiArticle(String prompt, String fallbackTitle) {
  checkWiFiConnection();

  WiFiClientSecure client;
  client.setInsecure(); // SSL bez ověřování CA certifikátu
  client.setTimeout(25000);

  Serial.println("Připojování ke Gemini API (generativelanguage.googleapis.com)...");
  if (!client.connect("generativelanguage.googleapis.com", 443)) {
    Serial.println("Nelze se připojit ke generativelanguage.googleapis.com");
    soundError();
    drawErrorScreen("Chyba sítě", "Nelze se spojit s Gemini servery.");
    return;
  }

  // Ošetření promptu proti rozbití JSON formátu
  String safePrompt = prompt;
  safePrompt.replace("\\", "\\\\");
  safePrompt.replace("\"", "\\\"");
  safePrompt.replace("\r", " ");
  safePrompt.replace("\n", " ");

  // Sestavení JSON pro Gemini 3.6 Flash
  // DŮLEŽITÉ: maxOutputTokens musí být 2048, protože model gemini-3.6-flash
  // započítává do limitu i myšlenkové tokeny (thinking).
  String requestBody = "{"
    "\"contents\":[{\"parts\":[{\"text\":\"" + safePrompt + "\"}]}],"
    "\"generationConfig\":{"
      "\"maxOutputTokens\":2048,"
      "\"temperature\":0.7,"
      "\"thinkingConfig\":{\"thinkingLevel\":\"low\"}"
    "}"
  "}";

  String path = "/v1beta/models/" + String(GEMINI_MODEL) + ":generateContent?key=" + String(GEMINI_API_KEY);

  Serial.println("Odesilam dotaz na Gemini (" + String(GEMINI_MODEL) + ")...");
  client.println("POST " + path + " HTTP/1.1");
  client.println("Host: generativelanguage.googleapis.com");
  client.println("Content-Type: application/json");
  client.print("Content-Length: ");
  client.println(requestBody.length());
  client.println("Connection: close");
  client.println();
  client.print(requestBody);

  // Čtení stavového kódu HTTP (např. HTTP/1.1 200 OK)
  int statusCode = 0;
  long startTime = millis();
  while (client.connected() || client.available()) {
    if (client.available()) {
      String statusLine = client.readStringUntil('\n');
      int firstSpace = statusLine.indexOf(' ');
      if (firstSpace > 0) {
        statusCode = statusLine.substring(firstSpace + 1, firstSpace + 4).toInt();
      }
      break;
    }
    if (millis() - startTime > 25000) {
      Serial.println("Timeout čekání na odpověď Gemini.");
      break;
    }
  }

  // Přeskočení HTTP hlaviček až do prázdného řádku
  while (client.connected() || client.available()) {
    String headerLine = client.readStringUntil('\n');
    if (headerLine == "\r" || headerLine.length() == 0) {
      break;
    }
  }

  // Čtení samotného těla (JSON)
  String responseBody = "";
  long readTimeout = millis();
  while (client.connected() || client.available()) {
    if (client.available()) {
      responseBody += client.readString();
      readTimeout = millis();
    }
    if (millis() - readTimeout > 15000) {
      break;
    }
  }
  client.stop();

  Serial.printf("Gemini HTTP status: %d\n", statusCode);

  if (statusCode != 200) {
    Serial.println("Chyba Gemini API odpověď:");
    Serial.println(responseBody);
    soundError();
    drawErrorScreen("Chyba Gemini", "HTTP kód: " + String(statusCode));
    return;
  }

  // Oříznutí na čistý JSON objekt pro případ chunked encoding
  int jsonStart = responseBody.indexOf('{');
  int jsonEnd = responseBody.lastIndexOf('}');
  if (jsonStart >= 0 && jsonEnd > jsonStart) {
    responseBody = responseBody.substring(jsonStart, jsonEnd + 1);
  }

  JsonDocument resDoc;
  DeserializationError err = deserializeJson(resDoc, responseBody);

  if (!err && resDoc.containsKey("candidates")) {
    JsonArray parts = resDoc["candidates"][0]["content"]["parts"].as<JsonArray>();
    String fullResponse = "";
    for (JsonObject p : parts) {
      // Přeskočíme případné myšlenkové tokeny (thought)
      if (p.containsKey("thought") && p["thought"].as<bool>()) {
        continue;
      }
      if (p.containsKey("text")) {
        fullResponse += p["text"].as<String>();
      }
    }
    
    fullResponse = cleanMarkdown(fullResponse);
    fullResponse.trim();

    // Oddělení titulku (1. řádek) a textu článku
    int firstNewLine = fullResponse.indexOf('\n');
    if (firstNewLine > 0) {
      currentTitle = fullResponse.substring(0, firstNewLine);
      currentTitle.trim();
      currentText = fullResponse.substring(firstNewLine + 1);
      currentText.trim();
    } else {
      currentTitle = fallbackTitle;
      currentText = fullResponse;
    }

    currentPage = 0;
    isReadingArticle = true;
    drawCurrentArticlePage();
  } else {
    soundError();
    Serial.printf("Chyba deserializace JSON: %s\n", err.c_str());
    drawErrorScreen("Chyba dat", "Gemini vrátilo nečitelný format JSON.");
  }
}

// =========================================================================
//  HLASOVÉ NAHRÁVÁNÍ A PŘEPIS (Google Speech-to-Text nebo Whisper)
// =========================================================================
#if USE_GOOGLE_SPEECH
// --- GOOGLE CLOUD SPEECH-TO-TEXT ---
String transcribeAudioGoogle(int16_t* audioBuffer, int sampleCount) {
  checkWiFiConnection();

  // Kódování audia do Base64
  size_t inputLen = sampleCount * 2;
  size_t b64Len = 0;
  mbedtls_base64_encode(NULL, 0, &b64Len, (const unsigned char*)audioBuffer, inputLen);
  
  char* b64Buffer = (char*)ps_malloc(b64Len + 1);
  if (!b64Buffer) b64Buffer = (char*)malloc(b64Len + 1);
  if (!b64Buffer) {
    Serial.println("Nedostatek paměti pro Base64 audio!");
    return "";
  }

  size_t actualLen = 0;
  mbedtls_base64_encode((unsigned char*)b64Buffer, b64Len + 1, &actualLen, (const unsigned char*)audioBuffer, inputLen);
  b64Buffer[actualLen] = '\0';

  WiFiClientSecure client;
  client.setInsecure();
  client.setTimeout(25000);

  Serial.println("Připojovaní ke Google Speech-to-Text API...");
  if (!client.connect("speech.googleapis.com", 443)) {
    Serial.println("Nelze se připojit ke speech.googleapis.com");
    free(b64Buffer);
    return "";
  }

  String head = "{\"config\":{\"encoding\":\"LINEAR16\",\"sampleRateHertz\":16000,\"languageCode\":\"cs-CZ\"},\"audio\":{\"content\":\"";
  String tail = "\"}}";
  int totalContentLength = head.length() + actualLen + tail.length();

  client.println("POST /v1/speech:recognize?key=" + String(GOOGLE_SPEECH_KEY) + " HTTP/1.1");
  client.println("Host: speech.googleapis.com");
  client.println("Content-Type: application/json");
  client.print("Content-Length: ");
  client.println(totalContentLength);
  client.println("Connection: close");
  client.println();

  // Streamované odeslání bez nutnosti alokovat velký řetězec v paměti
  client.print(head);
  client.write((const uint8_t*)b64Buffer, actualLen);
  client.print(tail);

  free(b64Buffer); // Uvolnění Base64 z paměti

  Serial.println("Audio odesláno, čekám na přepis...");

  String response = "";
  bool headersPassed = false;
  long timeout = millis();

  while (client.connected() || client.available()) {
    if (client.available()) {
      String line = client.readStringUntil('\n');
      if (line == "\r") {
        headersPassed = true;
      } else if (headersPassed) {
        response += line;
      }
      timeout = millis();
    }
    if (millis() - timeout > 15000) {
      Serial.println("Timeout čekání na Google Speech");
      break;
    }
  }
  client.stop();

  Serial.println("Google Speech odpověď:");
  Serial.println(response);

  // Oříznutí HTTP chunked přenosových kódů (např. 11c ... 0) na čistý JSON objekt
  int jsonStart = response.indexOf('{');
  int jsonEnd = response.lastIndexOf('}');
  if (jsonStart >= 0 && jsonEnd > jsonStart) {
    response = response.substring(jsonStart, jsonEnd + 1);
  }

  JsonDocument doc;
  DeserializationError err = deserializeJson(doc, response);
  if (!err && doc.containsKey("results")) {
    JsonArray results = doc["results"].as<JsonArray>();
    if (results.size() > 0) {
      String transcript = results[0]["alternatives"][0]["transcript"].as<String>();
      Serial.println("Úspěšně rozpoznaný text: " + transcript);
      return cleanPunctuation(transcript);
    }
  } else if (err) {
    Serial.printf("Chyba deserializace JSON: %s\n", err.c_str());
  }

  return "";
}

#else
// --- OPENAI WHISPER ---
String transcribeAudioWhisper(int16_t* audioBuffer, int sampleCount) {
  checkWiFiConnection();

  WiFiClientSecure client;
  client.setInsecure(); 
  
  const char* host = "api.openai.com";
  if (!client.connect(host, 443)) {
    Serial.println("Chyba připojování k OpenAI");
    return "";
  }
  
  String boundary = "----WebKitFormBoundary7MA4YWxkTrZu0gW";
  
  WAVHeader wavHeader;
  wavHeader.dataSize = sampleCount * 2;
  wavHeader.chunkSize = 36 + wavHeader.dataSize;
  
  String head = "--" + boundary + "\r\n";
  head += "Content-Disposition: form-data; name=\"file\"; filename=\"audio.wav\"\r\n";
  head += "Content-Type: audio/wav\r\n\r\n";
  
  String tail = "\r\n--" + boundary + "\r\n";
  tail += "Content-Disposition: form-data; name=\"model\"\r\n\r\n";
  tail += "whisper-1\r\n";
  tail += "--" + boundary + "\r\n";
  tail += "Content-Disposition: form-data; name=\"language\"\r\n\r\n";
  tail += "cs\r\n";
  tail += "--" + boundary + "--\r\n";
  
  uint32_t contentLength = head.length() + sizeof(WAVHeader) + (sampleCount * 2) + tail.length();
  
  client.println("POST /v1/audio/transcriptions HTTP/1.1");
  client.println("Host: api.openai.com");
  client.print("Authorization: Bearer ");
  client.println(OPENAI_API_KEY);
  client.print("Content-Type: multipart/form-data; boundary=");
  client.println(boundary);
  client.print("Content-Length: ");
  client.println(contentLength);
  client.println();
  
  client.print(head);
  client.write((uint8_t*)&wavHeader, sizeof(WAVHeader));
  client.write((uint8_t*)audioBuffer, sampleCount * 2);
  client.print(tail);
  
  String response = "";
  bool headersPassed = false;
  long timeout = millis();
  while (client.connected() || client.available()) {
    if (client.available()) {
      String line = client.readStringUntil('\n');
      if (line == "\r") {
        headersPassed = true;
      } else if (headersPassed) {
        response += line;
      }
      timeout = millis();
    }
    if (millis() - timeout > 10000) break;
  }
  client.stop();

  JsonDocument doc;
  DeserializationError err = deserializeJson(doc, response);
  if (!err && doc.containsKey("text")) {
    String query = doc["text"].as<String>();
    return cleanPunctuation(query);
  }
  return "";
}
#endif

// --- HLAVNÍ METODA NAHRÁVÁNÍ A VYHLEDÁNÍ ---
void recordAndSearch() {
  drawLoadingScreen("Mluvte teď...", "Říkejte dotaz do mikrofonu...");
  soundRecordStart();

  int maxSamples = 16000 * 5; // Až 5 sekund záznamu
  int16_t* audioBuffer = (int16_t*)ps_malloc(maxSamples * 2);
  if (!audioBuffer) audioBuffer = (int16_t*)malloc(maxSamples * 2);
  
  if (!audioBuffer) {
    soundError();
    drawErrorScreen("Chyba paměti", "Nedostatek RAM pro nahrávání.");
    return;
  }

  int sampleCount = 0;
  size_t bytesRead;
  int32_t rawSample = 0;
  
  // Vyčistíme starý šum v bufferu mikrofonu
  i2s_read(I2S_NUM_0, &rawSample, 4, &bytesRead, 100);

  // CHYTRÉ NAHRÁVÁNÍ:
  // Podporuje jak pouhé kliknutí (stisk a puštění), tak držení tlačítka.
  // Nahrává po dobu řeči (až 4.5 sekundy).
  // Pokud uživatel tlačítko drží a pustí ho po více než 1.8 s, nahrávání se ukončí.
  // Pokud uživatel jen kliknul, nahrává celých 4.5 s nebo dokud nestiskne tlačítko znovu po 1.5 s.
  delay(120); // Debounce
  bool buttonHeld = (digitalRead(BTN_SEARCH) == HIGH);
  unsigned long startRecordTime = millis();
  const unsigned long MAX_RECORD_MS = 4500; // Maximálně 4.5 sekundy
  const unsigned long MIN_RECORD_MS = 1800; // Minimální délka záznamu (proti useknutí)

  while (sampleCount < maxSamples) {
    unsigned long elapsed = millis() - startRecordTime;
    if (elapsed >= MAX_RECORD_MS) break;

    i2s_read(I2S_NUM_0, &rawSample, 4, &bytesRead, portMAX_DELAY);
    rawSample >>= 14; 
    audioBuffer[sampleCount++] = (int16_t)rawSample;

    // Pokud uživatel tlačítko držel, ukončíme po uvolnění (ale až po dosažení minimálního času)
    if (buttonHeld && elapsed >= MIN_RECORD_MS && digitalRead(BTN_SEARCH) == LOW) {
      break;
    }
    // Pokud uživatel jen kliknul (rychle pustil), může nahrávání ukončit dalším stiskem po 1.5 s
    if (!buttonHeld && elapsed >= 1500 && digitalRead(BTN_SEARCH) == HIGH) {
      break;
    }
  }

  soundRecordStop();
  drawLoadingScreen("Rozpoznávám hlas...", "Google Speech převádi audio");

  String transcribedQuery = "";
#if USE_GOOGLE_SPEECH
  transcribedQuery = transcribeAudioGoogle(audioBuffer, sampleCount);
#else
  transcribedQuery = transcribeAudioWhisper(audioBuffer, sampleCount);
#endif

  free(audioBuffer); // Uvolnění nahrávky

  if (transcribedQuery.length() == 0) {
    soundError();
    Serial.println("Nepodařilo se rozpoznat hlas.");
    drawErrorScreen("Nerozuměl jsem", "Zkuste mluvit zblízka do mikrofonu.");
    return;
  }

  Serial.println("Rozpoznaný dotaz: " + transcribedQuery);
  drawLoadingScreen("Dotaz: " + transcribedQuery, "Gemini hledá presná fakta");

  // Dotaz na Gemini s položenou otázkou - reálná fakta jako v telefonu
  String geminiPrompt = "Odpovez na nasledujici dotaz vecne, presne a s realnymi fakty jako inteligentni encyklopedie nebo Gemini v telefonu. "
                        "Odpovez v cestine. Zadny markdown, zadne hvezdicky, zadne uvozovky, zadne odrazky. "
                        "Na 1. radku POUZE vystizny a strucny nazev hesla (max 4 slova). "
                        "Pak jeden prazdny radek. "
                        "Pak samotny text clanku s podrobnymi fakty a vysvetlenim (cca 120 az 200 slov). "
                        "DOTAZ: " + transcribedQuery;

  fetchGeminiArticle(geminiPrompt, transcribedQuery);
}

// =========================================================================
//  GRAFICKÉ FUNKCE PRO E-PAPER DISPLEJ
// =========================================================================
int printWrappedText(String text, int startX, int startY, int maxWidth) {
  int x = startX;
  int y = startY;
  int lineHeight = u8g2Fonts.getFontAscent() - u8g2Fonts.getFontDescent() + 4; 
  
  String word = "";
  for (int i = 0; i <= text.length(); i++) {
    char c = (i < text.length()) ? text.charAt(i) : ' ';
    if (c == ' ' || c == '\n' || i == text.length()) {
      if (word.length() > 0) {
        int wordWidth = u8g2Fonts.getUTF8Width(word.c_str());
        if (x + wordWidth > startX + maxWidth) {
          x = startX;
          y += lineHeight;
        }
        u8g2Fonts.setCursor(x, y);
        u8g2Fonts.print(word);
        x += wordWidth + u8g2Fonts.getUTF8Width(" ");
        word = "";
      }
      if (c == '\n') {
        x = startX;
        y += lineHeight;
      }
    } else {
      word += c;
    }
  }
  return y;
}

void drawCurrentArticlePage() {
  display.setFullWindow();
  display.firstPage();
  do {
    display.fillScreen(GxEPD_WHITE);
    
    // Černá horní lišta
    display.fillRect(0, 0, 300, 25, GxEPD_BLACK);
    u8g2Fonts.setForegroundColor(GxEPD_WHITE);
    u8g2Fonts.setBackgroundColor(GxEPD_BLACK);
    u8g2Fonts.setFont(u8g2_font_helvB12_te); 
    
    u8g2Fonts.setCursor(10, 18);
    u8g2Fonts.print("Mk.III (Gemini)");
    
    int maxPages = (currentText.length() <= 0) ? 1 : ((currentText.length() - 1) / CHARS_PER_PAGE + 1);
    u8g2Fonts.setCursor(215, 18);
    u8g2Fonts.print("STR " + String(currentPage + 1) + "/" + String(maxPages));

    // Červený titulek (dynamicky zalomený)
    u8g2Fonts.setForegroundColor(GxEPD_RED);
    u8g2Fonts.setBackgroundColor(GxEPD_WHITE);
    u8g2Fonts.setFont(u8g2_font_helvB14_te); 
    
    int titleEndY = printWrappedText(currentTitle, 10, 50, 280);

    // Červená oddělovací linka dynamicky pod titulkem
    int lineY = titleEndY + 8;
    display.fillRect(10, lineY, 280, 2, GxEPD_RED);

    // Text článku přehledně pod linkou
    u8g2Fonts.setForegroundColor(GxEPD_BLACK);
    u8g2Fonts.setFont(u8g2_font_helvB10_te); 
    
    int startIndex = currentPage * CHARS_PER_PAGE;
    int endIndex = startIndex + CHARS_PER_PAGE;
    if (endIndex > currentText.length()) endIndex = currentText.length();
    
    String pageText = currentText.substring(startIndex, endIndex);
    if (endIndex < currentText.length()) pageText += "..."; 
    
    printWrappedText(pageText, 10, lineY + 20, 280);
    
  } while (display.nextPage());
}

void drawLoadingScreen(String title, String subtitle) {
  display.setFullWindow();
  display.firstPage();
  do {
    display.fillScreen(GxEPD_WHITE);
    
    display.fillRect(0, 0, 300, 25, GxEPD_BLACK);
    u8g2Fonts.setForegroundColor(GxEPD_WHITE);
    u8g2Fonts.setBackgroundColor(GxEPD_BLACK);
    u8g2Fonts.setFont(u8g2_font_helvB12_te);
    u8g2Fonts.setCursor(10, 18);
    u8g2Fonts.print("STOPARUV PRUVODCE");

    u8g2Fonts.setForegroundColor(GxEPD_RED);
    u8g2Fonts.setBackgroundColor(GxEPD_WHITE);
    u8g2Fonts.setFont(u8g2_font_helvB14_te);
    u8g2Fonts.setCursor(15, 120);
    u8g2Fonts.print(title);

    display.fillRect(15, 140, 270, 2, GxEPD_RED);

    u8g2Fonts.setForegroundColor(GxEPD_BLACK);
    u8g2Fonts.setFont(u8g2_font_helvB10_te);
    printWrappedText(subtitle, 15, 175, 270);

  } while (display.nextPage());
}

void drawErrorScreen(String title, String message) {
  display.setFullWindow();
  display.firstPage();
  do {
    display.fillScreen(GxEPD_WHITE);
    
    display.fillRect(0, 0, 300, 25, GxEPD_BLACK);
    u8g2Fonts.setForegroundColor(GxEPD_WHITE);
    u8g2Fonts.setBackgroundColor(GxEPD_BLACK);
    u8g2Fonts.setFont(u8g2_font_helvB12_te);
    u8g2Fonts.setCursor(10, 18);
    u8g2Fonts.print("CHYBA SYSTÉMU");

    u8g2Fonts.setForegroundColor(GxEPD_RED);
    u8g2Fonts.setBackgroundColor(GxEPD_WHITE);
    u8g2Fonts.setFont(u8g2_font_helvB18_te);
    u8g2Fonts.setCursor(10, 90);
    u8g2Fonts.print(title);

    u8g2Fonts.setForegroundColor(GxEPD_BLACK);
    u8g2Fonts.setFont(u8g2_font_helvB12_te);
    printWrappedText(message, 10, 140, 280);

  } while (display.nextPage());
}

void drawHomeScreen() {
  isReadingArticle = false;
  display.setFullWindow();
  display.firstPage();
  do {
    display.fillScreen(GxEPD_WHITE);
    
    // Horni stavovy radek (vysoka 25 px)
    display.fillRect(0, 0, 300, 25, GxEPD_BLACK);
    u8g2Fonts.setForegroundColor(GxEPD_WHITE);
    u8g2Fonts.setBackgroundColor(GxEPD_BLACK);
    u8g2Fonts.setFont(u8g2_font_helvB12_te);
    
    u8g2Fonts.setCursor(10, 18);
    u8g2Fonts.print("Mk.III (Gemini AI)");
    u8g2Fonts.setCursor(215, 18);
    u8g2Fonts.print("WIFI OK");

    // Originální 200x200 logo vycentrovane na stred (sirka displeje 300 -> x = 50)
    // Logo uz samo obsahuje velkou usmevavou planetu i grafiku DON'T PANIC
    drawLogo(50, 35);

    // Cervena oddelovaci linka pod logem (y = 245)
    display.fillRect(25, 245, 250, 2, GxEPD_RED); 
    
    // Prehledne a kompaktni navigacni pokyny s mensim pismem (aby se vse krasne veslo)
    u8g2Fonts.setForegroundColor(GxEPD_BLACK);
    u8g2Fonts.setBackgroundColor(GxEPD_WHITE);
    u8g2Fonts.setFont(u8g2_font_helvB10_te);
    
    u8g2Fonts.setCursor(35, 275);
    u8g2Fonts.print("DOPRAVA :  Náhodné heslo");
    
    u8g2Fonts.setCursor(35, 305);
    u8g2Fonts.print("STŘED       :  Hlasový dotaz");
    
    u8g2Fonts.setCursor(35, 335);
    u8g2Fonts.print("NAH/DOL :  Čtení stran");

    u8g2Fonts.setCursor(35, 365);
    u8g2Fonts.print("VLEVO     :  Zpět na úvod");

  } while (display.nextPage());
}
